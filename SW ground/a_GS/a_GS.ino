// SW version: Ground Station 1
// Functions: telemetry receiver and MatLab user interface data handler
// Programmer/s: Davide Cagnoni
// Last edit: 06-02-2025
// Note: The code integrates some section wroten by Andrea Zaffino for the proper UART exchange of the data structure, refer to the
//       "UART_struct_receive" for further information and the original code version


//________________________________________________________________________________________________________________________________________________________________________________________________________________________________________

// Libraries 

#include <SoftwareSerial.h>
#include "heltec.h"  
#include <stdlib.h>
#include "transport_PPP.h"
#include "Arduino.h"
#include "EBYTE.h"

//______________________________________________________________________OLED images and variables________________________________________________________________________________________

const unsigned char CAGNONI[] PROGMEM = {
  0x00, 0x00, 0x00, 0x00, 0x00, 0x00, 0x00, 0x00, 0x00, 0x00, 0x00, 0x00, 
  0x00, 0x00, 0x00, 0x00, 0x00, 0x00, 0x00, 0x00, 0x00, 0x00, 0xF8, 0x3F, 
  0x00, 0x00, 0x00, 0x00, 0x00, 0x00, 0x00, 0x00, 0x00, 0x00, 0x00, 0x00, 
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  0x88, 0x24, 0x05, 0x02, };

const byte ROW_SPACE = 12; // Number of separation pixels between two text rows on the OLED

//______________________________________________________________________Variables and constant declaration________________________________________________________________________________________

// Debug variables
const int HS_BR = 9600;    // Boud rate for the output serial data
// If set to HIGH the program will provide as serial output the debug data WITHOUT the MatLab string
// IMPORTANT NOTE: When the debug is active the script won't run correctly due to temporization issues
const bool sys_debug_out = LOW;  // System variables debug data
const bool GTSU_debug_out = LOW; // GTSU variables debug data

// This flag is used to initialize the debug serial port, it turns on if at least one "function debug flag" has been raised
const bool debug_out = sys_debug_out || GTSU_debug_out;
                                            
// OLED characteristics
const byte OLED_H = 64;
const byte OLED_W = 128;

// GSTU variables
// GSTU struct (Ground Station Telemetry Unit)
/*  
Two struct are used for the GSTU, a TX structure from the SCH to the ground station (GSTU_TX_data_str) designed to send telemetry data,
and a RX structure from the ground station to the SCH (GSTU_RX_data_str) to receive ground commands
  
Each one of the struct "cells" can contain a variable, the struct is defined with enough cells to host all the largest structs data.
For some of them, not all the available cells will be used, in such cases the unused cells contain the variable 0 or, 
if they have been already used to store another data, the last value used.
They won't be read whether the string corresponding to that specific identifier does't foresee information in that specific cell.
Apart from the "identifier" which is a "byte" variable, all the other cells are configured as "uint 16"
*/

typedef struct __attribute__((__packed__))
 {
 byte identifier = 0; // This first variable contains the header for the struct identification
 float  f_data_1 = 0; 
 float  f_data_2 = 0;
 float  f_data_3 = 0; 
 float  f_data_4 = 0;
 float  f_data_5 = 0;
 float  f_data_6 = 0;
 float  f_data_7 = 0; 
 float  f_data_8 = 0; 
 float  f_data_9 = 0;
 }

GSTU_RX_data_str;
GSTU_RX_data_str GSTU_RX_data_str_loc;  //Local data struct  
GSTU_RX_data_str GSTU_RX_data_str_rec;  //Remote (UART received) data struct

// Structure texture with adding the "point to point protocol", being this buffer used to store the data coming from the several peripheral units, 
// it must be sized to receive the largest struct used (GSTU_RX_data_str)
volatile uint8_t tx_buffer[sizeof(GSTU_RX_data_str) * 2];

// Variables for the checksum of the received structs
uint16_t GSTU_last_str_sum_FAP  = 0;
uint16_t GSTU_last_str_sum_ESP  = 0;
uint16_t GSTU_last_str_sum_EP  = 0;
uint32_t GSTU_last_str_sum_LP  = 0; // This is the only value requiring a 32 bit space to be stored due to the GNSS coordinates
uint32_t GSTU_str_sum = 0;


// MIDS variables
const String STR_DIV = " ";      // Data divider for the MIDS strigs
String MatLab_string;            // Flight Attitude Panel string 

// Dummy scheduler, it assigns a specific time to each task (function) before switching to another one.
// If a task takes more time to be executed compared to assigned one, the next task will start whiele the last task is still running,
// Be sure to set a proper time for each function
 
// Assigned time for each task in [ms]
const int TASK_1_TIME = 800;
const int TASK_2_TIME = 50;

long int last_task_1_time = 0;
long int last_task_2_time = 0;

bool task_1_done = LOW;
bool task_2_done = LOW;

// When one of these flag is raised, the task scheduler will stop the corresponding task earlyer, executing the next one scheduled to save time
bool task_1_stop = LOW;
bool task_2_stop = LOW;

// Serial ports baud rate
const int GSTU_SS_BR = 9600;

//___________________________________________________________________________Pins numbers declaration_______________________________________________________________________________________________________________________

// GTSU pins
const byte GSTU_TX_PIN = 26;
const byte GSTU_RX_PIN = 25;
const byte GSTU_M0_PIN = 17;
const byte GSTU_M1_PIN = 27;
const byte GSTU_AX_PIN = 22;

//_______________________________________________________________________________________Objects inizialization___________________________________________________________________________

// Software Serial ports
SoftwareSerial GSTU_SS (GSTU_RX_PIN, GSTU_TX_PIN);   

// GSTU object creation
EBYTE GSTU(&GSTU_SS, GSTU_M0_PIN, GSTU_M1_PIN, GSTU_AX_PIN);

//________________________________________________________________________________________Functions declaration_____________________________________________________________________________

// Since the GSTU can work both as transmiter and receiver, two separate functions are used
void GSTU_management_TX();   
void GSTU_management_RX(); 
void MIDS();        // MatLab Interface Data Sender, functon used to send the data to the MatLab interface                     
void StructSum();   // Function used to sum all the data in the received structs 
//________________________________________________________________________________________Secondary functions declaration_____________________________________________________________________________



//___________________________________________________________________________________________________Setup and Loop__________________________________________________________________________________________________________________________________________________

void setup() 
 {
 // Leave the "Heltec.begin()" in the first position of the setup.
 // This function set baudrate and pinmode not compliant with the ones needed by the code

 // OLED initializing
 Heltec.begin(true, false, true);
 Heltec.display->setContrast(255);
 Heltec.display->setFont(ArialMT_Plain_10);

 Heltec.display->clear();
 Heltec.display->drawXbm(0, 0, OLED_W, OLED_H, CAGNONI);
 Heltec.display->display();
 delay(1500);
 Heltec.display->clear(); 
 Heltec.display->display();

 Heltec.display->drawString(0, ROW_SPACE, "SW version: 1.0");
 Heltec.display->drawString(0, ROW_SPACE*2, "Perform sys. checks:");
 Heltec.display->display();
 delay(500);

 // GSTU serial port initialization
 GSTU_SS.begin(GSTU_SS_BR);
 GSTU.init();
 Heltec.display->clear();
 Heltec.display->drawString(0, ROW_SPACE, "SW version: 1.0");
 Heltec.display->drawString(0, ROW_SPACE*2, "Perform sys. checks:");
 Heltec.display->display();
 Heltec.display->drawString(0, ROW_SPACE*3, "GSTU configured");
 Heltec.display->display(); 
 delay(1000);
 Heltec.display->clear();
 Heltec.display->display();
 memset(&GSTU_RX_data_str_loc, 0, sizeof(GSTU_RX_data_str_loc));
 memset(&GSTU_RX_data_str_rec, 0, sizeof(GSTU_RX_data_str_rec));

 Serial.begin(HS_BR);
 delay(100);
 }

void loop() 
 {
 /*
 while((millis()-last_task_1_time < TASK_1_TIME || task_1_done == LOW) && task_1_stop == LOW)
  {
  if(task_1_done == LOW)
   {
   task_1_done = HIGH;
   last_task_1_time = millis();
   }
  GSTU_management_RX();
  }

 while((millis()-last_task_2_time < TASK_2_TIME || task_2_done == LOW) && task_2_stop == LOW)
  {
  if(task_2_done == LOW)
   {
   task_2_done = HIGH;
   last_task_2_time = millis();
   }
  // This if statement is to stop the serial transmission of the MatLab string while the debug is active
  // to not crate misleading messages on the serial monitor
  if(debug_out == LOW)                      
   MIDS(); 
  }  
  
 // When all the tasks has been completed the task_done flags are zeroized to start again the tasks schedule
 task_1_done = LOW;
 task_2_done = LOW;

 task_1_stop = LOW;
 task_2_stop = LOW;*/
 GSTU_management_RX();
 }

//___________________________________________________________________________________________________________Functions________________________________________


// Be sure to use MAX_PPP_BUF_SIZE larger at least the double of the transmitted data, 
// this is useful in case of all the sent bytes are 0x5D o 0x5E, they will be doubled sent with an "escape"
uint8_t buf_in[MAX_PPP_BUF_SIZE];       // Received texture with the "point to point" protocol
uint8_t buf_out[MAX_PPP_BUF_SIZE / 2];  // Texture without the "point to point protocol"

//_____________________________________________________________________________________Functions to call to get the data structs coming from the peripheral units________________________________________

void GSTU_get_serial_data() 
 {
 e_PPP_extract_result ppp_res = DATA_INCOMPLETE;
 uint16_t buf_in_len = 0u;
 uint16_t buf_out_len = 0u;

 while (GSTU_SS.available() && (buf_in_len < sizeof(buf_in)))
  {
  buf_in[buf_in_len++] = GSTU_SS.read();
  }
  
 do  // The do-while cycle is used to extract possible multiple textures from the received buffer
  {
  buf_out_len = (uint16_t)(sizeof(buf_out));  
  // It is necessary to be recalled because it is used to indicate to PPP_extract() how big is the "output buffer" 
  // It reads the input buffer from the serial, extract it from the "point ot point protocol" and make it available in the output in "buf_out"
  ppp_res = PPP_extract(buf_in, buf_in_len, buf_out, &buf_out_len);
  // This to avoid a multiple buffer passage, it is useful in case of SUCCESS_DATA_PENDING, since passing 0, 
  // the function is commanded to not read the input buffer but to analyze the data present in the last texture received 
  buf_in_len = 0u;    

  if ((ppp_res == SUCCESS_END) || (ppp_res == SUCCESS_DATA_PENDING))
   {
   // Texture has been correctly received
   if (buf_out_len == sizeof(GSTU_RX_data_str_rec)) // The reeived data are checked to verify the compliancy with the expected structure
    {
    memcpy(&GSTU_RX_data_str_rec, buf_out, (size_t)buf_out_len); // The remote struct is populated with the incoming data
    }
   }
  } 
 while (ppp_res == SUCCESS_DATA_PENDING);
 }
 
